## config/west.yml
```yaml
manifest:
  defaults:
    remote: urob
    revision: v0.3 

  remotes:
    - name: urob
      url-base: https://github.com/urob
    - name: zmkfirmware
      url-base: https://github.com/zmkfirmware
    - name: petejohanson
      url-base: https://github.com/petejohanson

  projects:
    - name: zmk
      remote: zmkfirmware
      import: app/west.yml
      
    - name: zmk-auto-layer
      path: modules/auto-layer
    - name: zmk-helpers
      path: modules/helpers
    - name: zmk-leader-key
      path: modules/leader-key
    - name: zmk-tri-state
      path: modules/tri-state

    # Only source necessary Zephyr modules. Remove this entire section to restore
    # the default (needed for less common hardware).
    - name: zephyr
      remote: zmkfirmware
      revision: v3.5.0+zmk-fixes
      clone-depth: 1
      import:
        name-allowlist:
          - cmsis
          - hal_nordic
          - hal_rpi_pico
          - hal_stm32
          - lvgl
          - tinycrypt


    - name: blank-slate-zmk-module
      remote: petejohanson
      revision: main

  self:
    path: config
```
